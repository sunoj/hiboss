## terminal/main/Kconfig.projbuild
```kconfig
menu "hiboss Terminal Configuration"

    config WIFI_SSID
        string "WiFi SSID"
        default "myssid"
        help
            SSID of the WiFi network to connect to.

    config WIFI_PASSWORD
        string "WiFi Password"
        default "mypassword"
        help
            Password for the WiFi network.

    config HIBOSS_SERVER_URL
        string "hiboss Server URL"
        default "https://hiboss.example.com"
        help
            Base URL of the hiboss server (no trailing slash).

    config HIBOSS_BOSS_API_KEY
        string "Boss API Key"
        default ""
        help
            Boss API key for authenticating with the hiboss server.
            Get this from your hiboss admin.

endmenu
```
